## Intellidemand V4.2/drivers/cpufreq/Kconfig
```kconfig
program shall be able to set the CPU dynamically without having
      to enable the userspace governor manually.
  
 +config CPU_FREQ_DEFAULT_GOV_INTELLIDEMAND
 +  bool "intellidemand"
 +  select CPU_FREQ_GOV_INTELLIDEMAND
 +  help
 +    Use the CPUFreq governor 'intellidemand' as default. This is
 +    based on Ondemand with browsing detection based on GPU loading.
 +
  config CPU_FREQ_DEFAULT_GOV_ONDEMAND
    bool "ondemand"
    select CPU_FREQ_GOV_ONDEMAND
 @@ -166,6 +173,24 @@ config CPU_FREQ_GOV_ONDEMAND
  
      If in doubt, say N.
  
 +config CPU_FREQ_GOV_INTELLIDEMAND
 +        tristate "'intellidemand' cpufreq policy governor"
 +        select CPU_FREQ_TABLE
 +        help
 +          'intellidemand' - This driver adds a dynamic cpufreq policy governor.
 +          The governor does a periodic polling and
 +          changes frequency based on the CPU utilization.
 +          The support for this governor depends on CPU capability to
 +          do fast frequency switching (i.e, very low latency frequency
 +          transitions). with browsing detection based on GPU loading
 +
 +          To compile this driver as a module, choose M here: the
 +          module will be called cpufreq_ondemand.
 +
 +          For details, take a look at linux/Documentation/cpu-freq.
 +
 +          If in doubt, say N.
 +
  config CPU_FREQ_GOV_INTERACTIVE
    tristate "'interactive' cpufreq policy governor"
    help
```
